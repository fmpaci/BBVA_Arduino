/**************************************************************************
 This is an example for our Monochrome OLEDs based on SSD1306 drivers

 Pick one up today in the adafruit shop!
 ------> http://www.adafruit.com/category/63_98

 This example is for a 128x32 pixel display using I2C to communicate
 3 pins are required to interface (two I2C and one reset).

 Adafruit invests time and resources providing this open
 source code, please support Adafruit and open-source
 hardware by purchasing products from Adafruit!

 Written by Limor Fried/Ladyada for Adafruit Industries,
 with contributions from the open source community.
 BSD license, check license.txt for more information
 All text above, and the splash screen below must be
 included in any redistribution.
 
 
 
I2C device found at address 0x3C  pantalla
I2C device found at address 0x57  ! EEPROM, ver como usarla
I2C device found at address 0x68  RTC
I2C device found at address 0x76  Sensor de Temperatura


 **************************************************************************/

#include <SPI.h>
#include <Wire.h> 
#include <DS3231.h>
#include <Adafruit_GFX.h>
#include <Adafruit_SSD1306.h>
#include <Adafruit_BMP280.h>




#define SCREEN_WIDTH 128 // OLED display width, in pixels
#define SCREEN_HEIGHT 64 // OLED display height, in pixels


#define OLED_RESET     -1 // Reset pin # (or -1 if sharing Arduino reset pin)
Adafruit_SSD1306 display(SCREEN_WIDTH, SCREEN_HEIGHT, &Wire, OLED_RESET);
Adafruit_BMP280 bmp; // I2C
DS3231 Clock;

#define LOGO1_WIDTH    128
#define LOGO1_HEIGHT   64

// 'logo2', 128x64px
const unsigned char logo1[] PROGMEM = {
  0x00, 0x00, 0x00, 0x00, 0x00, 0x00, 0x00, 0x00, 0x00, 0x00, 0x00, 0x00, 0x00, 0x00, 0x00, 0x00, 
  0x00, 0x00, 0x00, 0x00, 0x00, 0x00, 0x00, 0x00, 0x00, 0x00, 0x00, 0x00, 0x00, 0x00, 0x00, 0x00, 
  0x00, 0x00, 0x00, 0x00, 0x00, 0x00, 0x00, 0x00, 0x00, 0x00, 0x00, 0x00, 0x00, 0x00, 0x00, 0x00, 
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  0x00, 0x00, 0x00, 0x00, 0x00, 0x00, 0x00, 0x00, 0x00, 0x00, 0x00, 0x00, 0x00, 0x00, 0x00, 0x00
};




#define VUMeter_WIDTH    128
#define VUMeter_HEIGHT   64
static const unsigned char  VUMeter[] PROGMEM = { 
  /*0x00, 0x00, 0x00, 0x00, 0x00, 0x00, 0x00, 0x00, 0x00, 0x00, 0x00, 0x00, 0x00, 0x00, 0x00, 0x00,
  0x00, 0x00, 0x00, 0x00, 0x00, 0x00, 0x00, 0x00, 0x00, 0x00, 0x00, 0x00, 0x00, 0x00, 0x00, 0x00,
  0x00, 0x00, 0x00, 0x00, 0x00, 0x00, 0x00, 0x00, 0x00, 0x00, 0x00, 0x00, 0x00, 0x00, 0x00, 0x00,
  0x00, 0x00, 0x00, 0x00, 0x00, 0x00, 0x00, 0x00, 0x00, 0x00, 0x00, 0x00, 0x00, 0x00, 0x00, 0x00,
  0x00, 0x00, 0x00, 0x00, 0x00, 0x00, 0x00, 0x00, 0x00, 0x00, 0x00, 0x00, 0x00, 0x00, 0x00, 0x00,*/
  0x00, 0x00, 0x00, 0x00, 0x00, 0x00, 0x06, 0x03, 0x00, 0x60, 0xC0, 0x00, 0x00, 0x00, 0x00, 0x00,
  0x00, 0x00, 0x00, 0x00, 0x00, 0x78, 0x09, 0x04, 0x80, 0x21, 0x20, 0x00, 0x00, 0x00, 0x00, 0x00,
  0x00, 0x00, 0x00, 0x01, 0x98, 0x08, 0x06, 0x03, 0x80, 0x21, 0x20, 0x00, 0x00, 0x00, 0x00, 0x00,
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  0x00, 0x00, 0x05, 0x00, 0x00, 0x00, 0x00, 0x70, 0x19, 0x80, 0x00, 0x00, 0x00, 0x00, 0x00, 0x00,
  0x00, 0x00, 0x02, 0x00, 0x00, 0x00, 0x00, 0x20, 0x0F, 0x00, 0x00, 0x00, 0x00, 0x00, 0x00, 0x00/*,
  0x00, 0x00, 0x00, 0x00, 0x00, 0x00, 0x00, 0x00, 0x00, 0x00, 0x00, 0x00, 0x00, 0x00, 0x00, 0x00,
  0x00, 0x00, 0x00, 0x00, 0x00, 0x00, 0x00, 0x00, 0x00, 0x00, 0x00, 0x00, 0x00, 0x00, 0x00, 0x00,
  0x00, 0x00, 0x00, 0x00, 0x00, 0x00, 0x00, 0x00, 0x00, 0x00, 0x00, 0x00, 0x00, 0x00, 0x00, 0x00,
  0x00, 0x00, 0x00, 0x00, 0x00, 0x00, 0x00, 0x00, 0x00, 0x00, 0x00, 0x00, 0x00, 0x00, 0x00, 0x00,
  0x00, 0x00, 0x00, 0x00, 0x00, 0x00, 0x00, 0x00, 0x00, 0x00, 0x00, 0x00, 0x00, 0x00, 0x00, 0x00,
  0x00, 0x00, 0x00, 0x00, 0x00, 0x00, 0x00, 0x00, 0x00, 0x00, 0x00, 0x00, 0x00, 0x00, 0x00, 0x00,
  0x00, 0x00, 0x00, 0x00, 0x00, 0x00, 0x00, 0x00, 0x00, 0x00, 0x00, 0x00, 0x00, 0x00, 0x00, 0x00,
  0x00, 0x00, 0x00, 0x00, 0x00, 0x00, 0x00, 0x00, 0x00, 0x00, 0x00, 0x00, 0x00, 0x00, 0x00, 0x00,
  0x00, 0x00, 0x00, 0x00, 0x00, 0x00, 0x00, 0x00, 0x00, 0x00, 0x00, 0x00, 0x00, 0x00, 0x00, 0x00,
  0x00, 0x00, 0x00, 0x00, 0x00, 0x00, 0x00, 0x00, 0x00, 0x00, 0x00, 0x00, 0x00, 0x00, 0x00, 0x00,
  0x00, 0x00, 0x00, 0x00, 0x00, 0x00, 0x00, 0x00, 0x00, 0x00, 0x00, 0x00, 0x00, 0x00, 0x00, 0x00,
  0x00, 0x00, 0x00, 0x00, 0x00, 0x00, 0x00, 0x00, 0x00, 0x00, 0x00, 0x00, 0x00, 0x00, 0x00, 0x00,
  0x00, 0x00, 0x00, 0x00, 0x00, 0x00, 0x00, 0x00, 0x00, 0x00, 0x00, 0x00, 0x00, 0x00, 0x00, 0x00,
  0x00, 0x00, 0x00, 0x00, 0x00, 0x00, 0x00, 0x00, 0x00, 0x00, 0x00, 0x00, 0x00, 0x00, 0x00, 0x00,
  0x00, 0x00, 0x00, 0x00, 0x00, 0x00, 0x00, 0x00, 0x00, 0x00, 0x00, 0x00, 0x00, 0x00, 0x00, 0x00,
  0x00, 0x00, 0x00, 0x00, 0x00, 0x00, 0x00, 0x00, 0x00, 0x00, 0x00, 0x00, 0x00, 0x00, 0x00, 0x00,
  0x00, 0x00, 0x00, 0x00, 0x00, 0x00, 0x00, 0x00, 0x00, 0x00, 0x00, 0x00, 0x00, 0x00, 0x00, 0x00,
  0x00, 0x00, 0x00, 0x00, 0x00, 0x00, 0x00, 0x00, 0x00, 0x00, 0x00, 0x00, 0x00, 0x00, 0x00, 0x00,
  0x00, 0x00, 0x00, 0x00, 0x00, 0x00, 0x00, 0x00, 0x00, 0x00, 0x00, 0x00, 0x00, 0x00, 0x00, 0x00,
  0x00, 0x00, 0x00, 0x00, 0x00, 0x00, 0x00, 0x00, 0x00, 0x00, 0x00, 0x00, 0x00, 0x00, 0x00, 0x00,
  0x00, 0x00, 0x00, 0x00, 0x00, 0x00, 0x00, 0x00, 0x00, 0x00, 0x00, 0x00, 0x00, 0x00, 0x00, 0x00,
  0x00, 0x00, 0x00, 0x00, 0x00, 0x00, 0x00, 0x00, 0x00, 0x00, 0x00, 0x00, 0x00, 0x00, 0x00, 0x00,
  0x00, 0x00, 0x00, 0x00, 0x00, 0x00, 0x00, 0x00, 0x00, 0x00, 0x00, 0x00, 0x00, 0x00, 0x00, 0x00,
  0x00, 0x00, 0x00, 0x00, 0x00, 0x00, 0x00, 0x00, 0x00, 0x00, 0x00, 0x00, 0x00, 0x00, 0x00, 0x00,
  0x00, 0x00, 0x00, 0x00, 0x00, 0x00, 0x00, 0x00, 0x00, 0x00, 0x00, 0x00, 0x00, 0x00, 0x00, 0x00*/
};



#define LeYo_WIDTH    211
#define LeYo_HEIGHT   30
const unsigned char LeYo[] PROGMEM = {
 0x7f, 0xff, 0xf8, 0x3f, 0xff, 0xfe, 0x07, 0xff, 0xf8, 0x00, 0x1f, 0xff, 0xff, 0x00, 0x00, 0x7f, 
  0xff, 0x80, 0x00, 0x1f, 0xc0, 0x00, 0x00, 0xff, 0x00, 0x0f, 0xc0, 0x7f, 0xff, 0xf8, 0x3f, 0xff, 
  0xfe, 0x07, 0xff, 0xff, 0x00, 0x1f, 0xff, 0xff, 0x00, 0x00, 0x7f, 0xff, 0xe0, 0x00, 0x3f, 0xe0, 
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  0x00, 0x7e, 0x00, 0x03, 0xf0, 0x00, 0xff, 0x00, 0x0f, 0xc0
};


//503x64px
#define LeBigYo_WIDTH    324
#define LeBigYo_HEIGHT   64
const unsigned char LeBigYo [] PROGMEM = {
 0x00, 0x00, 0x00, 0x00, 0x00, 0x00, 0x00, 0x00, 0x00, 0x00, 0x00, 0x00, 0x00, 0x00, 0x00, 0x00, 
  0x00, 0x00, 0x00, 0x00, 0x00, 0x00, 0x00, 0x07, 0xff, 0xff, 0xc0, 0x00, 0x00, 0x3f, 0xff, 0xfe, 
  0x00, 0x00, 0x01, 0xff, 0xff, 0xf0, 0x00, 0x30, 0x00, 0x00, 0x7f, 0xff, 0xfc, 0x00, 0x00, 0x7f, 
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  0x00, 0x00, 0x00, 0x00, 0x00, 0x00, 0x00, 0x00, 0x00, 0x00, 0x00, 0x00, 0x00, 0x00, 0x00, 0x00
};

////////////variables globales para impresión
String Hora = "";
String Fecha = "";
String Temperatura = "";
String Nombre = "Federico Paci";
bool bInv = false;



////////////variables para el vúmetro
unsigned int sample;
int analogInput = A0;                 // analog input for outside audio source
int hMeter = 65;                      // horizontal center for needle animation
int vMeter = 85;                      // vertical center for needle animation (outside of dislay limits)
int rMeter = 80;                      // length of needle animation or arch of needle travel
const int sampleWindow = 50;          // sample window width in mS (50 mS = 20Hz)



////////////variables para el clock
int minute,hour,date,month,year; 


int cantidad=0;

void setup() {
  bool Century=false;
  bool h12;
  bool PM;
  pinMode(2, INPUT);
  pinMode(3, INPUT);
  Serial.begin(9600);

  /*
  Iniciar Display
  */
  if(!display.begin(SSD1306_SWITCHCAPVCC, 0x3C)) {
    Serial.println(F("SSD1306 allocation failed"));
    for(;;){}; // Don't proceed, loop forever
  }
  PrintLogo();

  if (!Clock.oscillatorCheck()) { /*para validar que está bien el oscilador del equipo*/
      Serial.println(F("Error al validar oscilador"));
    PrintTexto(0,0,"Error en  Reloj");
    for(;;){}; // Don't proceed, loop forever
  }else{
  /*Leer variables de la hora*/
    minute=Clock.getMinute();
    hour=Clock.getHour(h12, PM);
    date=Clock.getDate();
    month=Clock.getMonth(Century);
    year=Clock.getYear();
  }

  

  /*Iniciar el termometro*/
  if (!bmp.begin()) {
    Serial.println(("Error en sensor de temperatura"));
    PrintTexto(0,0,"Error en  Termometro");
    for(;;){}; // Don't proceed, loop forever
  }
  bmp.setSampling(Adafruit_BMP280::MODE_NORMAL,     /* Operating Mode. */
    Adafruit_BMP280::SAMPLING_X2,     /* Temp. oversampling */
    Adafruit_BMP280::SAMPLING_X16,    /* Pressure oversampling */
    Adafruit_BMP280::FILTER_X16,      /* Filtering. */
    Adafruit_BMP280::STANDBY_MS_500); /* Standby time. */
  display.invertDisplay(true);
  delay(500);
  display.invertDisplay(false);

  
}




void loop() {
  display.clearDisplay();
  cantidad = 0;
  unsigned long startMillis = millis();
  display.invertDisplay(bInv);
  bInv = !bInv;

  /*pantalla general*/
  //while (millis() - startMillis < 150000){
  if(digitalRead(3)==HIGH)    ImprimirNombreGrande();
  ImprimirNombreMarquesina();
  ImprimirNombreIdayVuelta();
  delay(500);
  //}
  PrintLogo();
  delay(400);
  if(digitalRead(2)==HIGH){
    startMillis = millis();
    while (millis() - startMillis < 30000){
      PrintVumeter();
    }
  }
}



void PrintLogo(void) {
  display.clearDisplay();
  display.drawBitmap( 0,0, logo1, 128, 64, 1);
  display.display();
  delay(500);
}


void LeerVariables(){

  Hora = "";
  Fecha = "";
  Temperatura = "";
  
  
  LeerReloj();
  Temperatura.concat(bmp.readTemperature());
  /**Formatear la hora y la temperatura*/
  if(hour<10){Hora.concat("0");}Hora.concat(hour); Hora.concat(":");
  if(minute<10){Hora.concat("0");}Hora.concat(minute);Hora.concat(" ");
  Hora.concat(Temperatura); //se agrega la temperatura a la variable hora para poder imprimir todo en la mimsa linea

  /**Leer y formatear la fecha*/
  if(date<10){Fecha.concat("0");} Fecha.concat(date);  //día
  Fecha.concat("/");  if(month<10){Fecha.concat("0");}Fecha.concat(month);   //mes
  Fecha.concat("/20");  Fecha.concat(year); //año

  /*
  Serial.print("Temp RTC: ");Serial.println(Clock.getTemperature(), 2);
  Serial.print("Temp BMP: ");Serial.println(bmp.readTemperature(),2);
  */
  
}


  
void LeerReloj(){
  /*Variables para imprimir en el display*/
  bool Century=false;
  bool h12;
  bool PM;
  int aux=minute;
  /*Leer las variables del Reloj*/
  minute=Clock.getMinute();
  if(aux != minute && aux > minute){ //si ya es otra hora
    aux = hour;
    hour=Clock.getHour(h12, PM);
    if(aux != hour && aux > hour){ //si ya es otro mes
      date=Clock.getDate();
      month=Clock.getMonth(Century);
      year=Clock.getYear();
    }
  }
}


void ImprimirNombreMarquesina(){
  int x;
  //LeerVariables();
  for(x=0;x>-(LeYo_WIDTH+30);x--){
  ImprimirVariables();
  if(x>(-LeYo_WIDTH)) display.drawBitmap(x, 17, LeYo, LeYo_WIDTH, LeYo_HEIGHT, WHITE);
  if(x<-(LeYo_WIDTH-SCREEN_WIDTH+30)) display.drawBitmap(x+LeYo_WIDTH+30, 17, LeYo, LeYo_WIDTH, LeYo_HEIGHT, WHITE);
  display.display();
  }
  
}




void ImprimirNombreIdayVuelta(){
  int x,i;
  //LeerVariables();
  for(i=0;i<2;i++){
    for(x=0;x > -(LeYo_WIDTH - SCREEN_WIDTH) ;x--){
      ImprimirVariables();
      //display.clearDisplay();
      display.drawBitmap(x, 17, LeYo, LeYo_WIDTH, LeYo_HEIGHT, WHITE);
      display.display();
    }
    delay(50);
    //LeerVariables();
    for(;x<0;x++){
      ImprimirVariables();
      //display.clearDisplay();
      display.drawBitmap(x, 17, LeYo, LeYo_WIDTH, LeYo_HEIGHT, WHITE);
      display.display();
    }
    delay(50);
  }
}


void ImprimirVariables(){
  LeerVariables();
  display.clearDisplay();
  display.setTextColor(WHITE);  
  display.setTextSize(2);
  display.setCursor(0, 1);
  display.println(Fecha);
  display.setCursor(0, 49);
  display.println(Hora);
  //display.write(248);
}
  






void PrintVumeter(void){
  unsigned long startMillis = millis();                    // start of sample window
  unsigned int PeaktoPeak = 0;                             // peak-to-peak level
  unsigned int SignalMax = 0;
  unsigned int SignalMin = 1024;
  
  while ( millis() - startMillis < sampleWindow ){

    sample = analogRead(analogInput);
    if (sample < 1024) {

      if (sample > SignalMax){

        SignalMax = sample;                                // saves just the max levels
      }

      else if (sample < SignalMin){

        SignalMin = sample;                                // saves just the min levels
      }
    }
  }
   PeaktoPeak = SignalMax - SignalMin;                      // max - min = peak-peak amplitude
  float MeterValue = PeaktoPeak * 330 / 1024;              // convert volts to arrow information

/****************************************************
 End of code taken from Adafruit Sound Level Sketch
*****************************************************/
  
  MeterValue = MeterValue - 34;                            // shifts needle to zero position
  display.clearDisplay();                                  // refresh display for next step
  display.drawBitmap(0, 5, VUMeter, 128, 34, WHITE);       // draws background
  int a1 = (hMeter + (sin(MeterValue / 57.296) * rMeter)); // meter needle horizontal coordinate
  int a2 = (vMeter - (cos(MeterValue / 57.296) * rMeter)); // meter needle vertical coordinate

  display.drawLine(a1, a2, hMeter, vMeter, WHITE);         // draws needle
  display.setTextColor(WHITE);
  display.setCursor(5, 49);
  display.setTextSize(2);
  display.println("Fede  Paci");
  display.display();
  display.display();

}



void PrintTexto(int x, int y, String texto){
  display.clearDisplay();
  display.setTextColor(WHITE);
  display.setCursor(x, y);
  display.setTextSize(2);
  display.println(texto);
  display.display();
}


void ImprimirNombreGrande(){
  int x;
 
    for(x=0;x>-(LeBigYo_WIDTH+30);x--){
      display.clearDisplay();
      if(x>(-LeBigYo_WIDTH)) display.drawBitmap(x, 0, LeBigYo, LeBigYo_WIDTH, LeBigYo_HEIGHT, WHITE);
      if(x<-(LeBigYo_WIDTH-SCREEN_WIDTH+30)) display.drawBitmap(x+LeBigYo_WIDTH+30, 0, LeBigYo, LeBigYo_WIDTH, LeBigYo_HEIGHT, WHITE);
      display.display();
    }
    
    
 
}
